## CMakeLists.txt
```
#
# Copyright (c) 2026 Nordic Semiconductor ASA
#
# SPDX-License-Identifier: LicenseRef-Nordic-5-Clause
#

cmake_minimum_required(VERSION 3.20.0)

find_package(Zephyr REQUIRED HINTS $ENV{ZEPHYR_BASE})
project(system-on)

target_sources(app PRIVATE src/main.c)
target_include_directories(app PRIVATE inc)
```

## prj.conf
```kconfig
CONFIG_SERIAL=n         # Do not initialize UART logger module
```

## src/main.c
```c
#include <zephyr/kernel.h>
int main(void)
{
	return 0;
}
```
