## l5/l5_e1_sol/sample.yaml
```yaml
sample:
  description: Designing Low Power Bluetooth LE devices Lesson 5 Exercise 1
  name: Low Power Bluetooth LE devices - Lesson 5 Exercise 1

common: 
    sysbuild: true
    build_only: true
    integration_platforms:
      - nrf54l15dk/nrf54l15/cpuapp

    platform_allow:
      - nrf54l15dk/nrf54l15/cpuapp


tests:
  l5.e1.sol: {} 
  
```

## l6/l6_e1_sol/sample.yaml
```yaml
sample:
  name: Lesson 6 Exercise - PMIC SW development

tests:
  sample.l6_e1_sol:
    extra_args: 
      - DTC_OVERLAY_FILE="./boards/nrf54l15dk_nrf54l15_cpuapp.overlay;npm2100_pmic.overlay;pmic_gpios.overlay"
    platform_allow:
      - nrf54l15dk/nrf54l15/cpuapp
    integration_platforms:
      - nrf54l15dk/nrf54l15/cpuapp
    sysbuild: true
    build_only: true
```
