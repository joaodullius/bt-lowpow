## sample.yaml
```
sample:
  description: Designing Low Power Bluetooth LE devices Lesson 3 Exercise 1 
  name: Low Power Bluetooth LE devices - Lesson 3 Exercise 1 

common: 
    sysbuild: true
    build_only: true
    skip: true

    integration_platforms:
      - nrf54l15dk/nrf54l15/cpuapp
      - nrf54l15dk/nrf54l10/cpuapp
      - nrf54l15dk/nrf54l05/cpuapp
      - nrf54lm20dk/nrf54lm20a/cpuapp
    platform_allow:
      - nrf54l15dk/nrf54l15/cpuapp
      - nrf54l15dk/nrf54l10/cpuapp
      - nrf54l15dk/nrf54l05/cpuapp
      - nrf54lm20dk/nrf54lm20a/cpuapp

tests:
  l3.e1: {} 
  
```

## prj.conf
```kconfig
#
# Copyright (c) 2026 Nordic Semiconductor
#
# SPDX-License-Identifier: LicenseRef-Nordic-5-Clause
#

# Logging
CONFIG_LOG=n
CONFIG_SERIAL=n

# Button and LED library
CONFIG_DK_LIBRARY=y

# Memory
CONFIG_SYSTEM_WORKQUEUE_STACK_SIZE=2048
CONFIG_MAIN_STACK_SIZE=2048

# Bluetooth LE
CONFIG_BT=y
CONFIG_BT_PERIPHERAL=y
CONFIG_BT_DEVICE_NAME="Nordic_Beacon"

# STEP 9.1 - Enable extended advertising
CONFIG_BT_EXT_ADV=y
```

## src/main.c
```c
/* STEP 4.2 - Turn off the low frequency clock, RAM sections for CRACKEN and ICACHE and enter system off */
```
